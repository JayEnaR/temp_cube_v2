## components/button/Kconfig.projbuild
```kconfig
menu "Button Configuration"

    config BUTTON_GPIO
        int "Button GPIO number"
        range 0 48
        default 0
        help
            GPIO pin connected to the device button.

    config BUTTON_LONG_PRESS_SEC
        int "Long press duration (seconds)"
        range 1 10
        default 3
        help
            Number of seconds the button must be held to erase NVS and restart
            provisioning.

endmenu
```

## components/mqtt-manager/Kconfig.projbuild
```kconfig
menu "MQTT Manager Configuration"

config MQTT_BROKER_URI
    string "MQTT broker URI"
    default "mqtt://broker.emqx.io"
    help
        Full URI of the MQTT broker to connect to.

config MQTT_READINGS_TOPIC
    string "BME280 readings publish topic"
    default "temp-cube/readings"
    help
        Topic used to publish temperature, humidity, pressure, and altitude readings.

config MQTT_QOS
    int "MQTT publish QoS"
    range 0 2
    default 1
    help
        QoS level used when publishing sensor readings.

config MQTT_KEEPALIVE_SEC
    int "MQTT keepalive interval (seconds)"
    default 60
    help
        Interval in seconds between MQTT keepalive pings.

config MQTT_CONNECT_TIMEOUT_MS
    int "MQTT connect timeout before publishing, in ms"
    default 5000
    help
        Maximum time to wait for the MQTT broker connection before skipping a publish.

endmenu
```

## components/ota-manager/Kconfig.projbuild
```kconfig
menu "OTA Manager Configuration"

config TEMP_CUBE_OTA_URL_MAX_LEN
    int "Maximum OTA firmware URL length"
    range 64 1024
    default 256
    help
        Maximum length of a firmware URL received from an OTA trigger.

config TEMP_CUBE_OTA_HTTP_TIMEOUT_MS
    int "OTA HTTP request timeout, in ms"
    default 30000
    help
        Timeout used by the HTTP client while downloading OTA firmware.

config TEMP_CUBE_OTA_ALLOW_HTTP
    bool "Allow plain HTTP OTA URLs"
    default y
    help
        Allow OTA downloads from http:// URLs. Disable this for production and
        use HTTPS firmware hosting.

config TEMP_CUBE_OTA_USE_CERT_BUNDLE
    bool "Use ESP x509 certificate bundle for HTTPS OTA"
    depends on MBEDTLS_CERTIFICATE_BUNDLE
    default y
    help
        Attach ESP-IDF's built-in certificate bundle when downloading firmware
        from HTTPS URLs.

config TEMP_CUBE_OTA_SKIP_LAST_SUCCESSFUL_URL
    bool "Skip retained OTA URL after a successful update"
    default y
    help
        Store the last successfully applied OTA URL in NVS and skip it on later
        boots. This prevents a retained MQTT OTA trigger from reflashing the
        same firmware every wake cycle.

endmenu
```

## components/soft-ap/Kconfig.projbuild
```kconfig
menu "Soft-AP Configuration"

    config SOFT_AP_SSID
        string "AP SSID"
        default "Temp Cube Setup"
        help
            SSID broadcast by the ESP32 in AP mode during provisioning.

    config SOFT_AP_PASSWORD
        string "AP Password"
        default "developer"
        help
            Password for the provisioning AP. Leave empty for an open network.

    config SOFT_AP_CHANNEL
        int "AP Wi-Fi Channel"
        range 1 13
        default 1
        help
            Wi-Fi channel used for the provisioning AP.

    config SOFT_AP_MAX_STA_CONN
        int "Maximum simultaneous station connections"
        range 1 10
        default 4
        help
            Maximum number of stations that can connect to the provisioning AP.

endmenu
```

## components/temp_cube_bme280/Kconfig.projbuild
```kconfig
menu "Temp Cube BME280"

config TEMP_CUBE_BME280_PRIMARY_I2C_ADDR
    hex "Primary BME280 I2C address"
    default 0x76
    help
        First 7-bit I2C address to probe for the BME280.

config TEMP_CUBE_BME280_SECONDARY_I2C_ADDR
    hex "Secondary BME280 I2C address"
    default 0x77
    help
        Fallback 7-bit I2C address to probe for the BME280.

config TEMP_CUBE_BME280_I2C_CLOCK_HZ
    int "BME280 I2C clock speed"
    default 100000
    help
        I2C clock speed used for the BME280 device on the shared bus.

config TEMP_CUBE_BME280_SEA_LEVEL_PRESSURE_PA
    int "Sea level pressure used for altitude, in Pa"
    default 101325
    help
        Sea level pressure used for barometric altitude calculations.

config TEMP_CUBE_BME280_UPDATE_INTERVAL_MS
    int "Sensor update interval, in ms"
    default 2000
    help
        Delay between sensor display updates.

endmenu
```
